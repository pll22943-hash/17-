## boards/shields/17mmless/Kconfig.defconfig
```kconfig
if SHIELD_17MMLESS_LEFT

config ZMK_KEYBOARD_NAME
    default "17mmless"

endif

if SHIELD_17MMLESS_LEFT || SHIELD_17MMLESS_RIGHT

config ZMK_SPLIT
    default y

endif
```

## boards/shields/17mmless/Kconfig.shield
```kconfig
config SHIELD_17MMLESS_LEFT
    def_bool $(shields_list_contains,17mmless_left)
config SHIELD_17MMLESS_RIGHT
    def_bool $(shields_list_contains,17mmless_right)
```
